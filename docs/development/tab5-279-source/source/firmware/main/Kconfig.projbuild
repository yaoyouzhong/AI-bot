## docs/development/tab5-279-source/source/firmware/main/Kconfig.projbuild
```kconfig
config TAB5_LCD_FLASH_SAFE
    bool
    default y if IDF_TARGET_ESP32P4
    select LCD_DSI_ISR_IRAM_SAFE
    select DW_GDMA_CTRL_FUNC_IN_IRAM
    select DW_GDMA_SETTER_FUNC_IN_IRAM
    select DW_GDMA_GETTER_FUNC_IN_IRAM
    help
        Keep the DSI scanout rearm interrupt and every DW-GDMA helper it calls
        available during flash erase/write, including OTA and asset caching.
```
